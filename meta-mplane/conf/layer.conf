## meta-mplane/conf/layer.conf
```bitbake
# We have a conf and classes directory, append to BBPATH
BBPATH .= ":${LAYERDIR}"

# Pick up a Facebook specific site.conf that defines
# variables only useful within facebook
# such as where the SSTATE cache is located.
BBPATH .= ":${LAYERDIR}/facebook"

# recipes can find top level directory with this yocto var
META_MPLANE_DIR := "${LAYERDIR}"

# We have a recipes directory, add to BBFILES
BBFILES += "${LAYERDIR}/recipes*/*/*.bb ${LAYERDIR}/recipes*/*/*.bbappend"

BBFILE_COLLECTIONS += "meta-mplane"
BBFILE_PATTERN_meta-mplane := "^${LAYERDIR}/"
BBFILE_PRIORITY_meta-mplane = "7"

LICENSE_PATH += "${LAYERDIR}/licenses"

# Do not install 'recommended' glibc debug symbols and sources
BAD_RECOMMENDATIONS = "${TCLIBC}-dbg"

# give recipes a pointer to toplevel mplane dir
META_MPLANE_DIR := "${LAYERDIR}"

LAYERSERIES_CORENAMES = "dunfell gatesgarth zeus thud"
LAYERSERIES_COMPAT_meta-mplane = "dunfell gatesgarth zeus thud"
```
